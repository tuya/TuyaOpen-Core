## iot-core/core_system/Kconfig
```kconfig
menu "Configure System Parameters"

    config STACK_SIZE_TIMERQ
        int "STACK_SIZE_TIMERQ: Set stack size for software timer queue"
        default 4096
        range 2048 16384

    config STACK_SIZE_WORK_QUEUE
        int "STACK_SIZE_WORK_QUEUE: Set stack size for work queue"
        default 5120
        range 2048 16384

    config MAX_NODE_NUM_WORK_QUEUE
        int "MAX_NODE_NUM_WORK_QUEUE: Set maximum node count in work queue"
        default 100
        range 10 1000

    config STACK_SIZE_MSG_QUEUE
        int "STACK_SIZE_MSG_QUEUE: Set stack size for message queue"
        default 4096
        range 2048 16384

    config MAX_NODE_NUM_MSG_QUEUE
        int "MAX_NODE_NUM_MSG_QUEUE: Set maximum node count in message queue"
        default 100
        range 10 1000

    config ENABLE_PLATFORM_NETWORK_OPS
        bool "ENABLE_PLATFORM_NETWORK_OPS: Dispatch core_network through platform ops card"
        default n
        help
            Selects how iot-core/core_system/src/core_network.c accesses the network stack:
            - y (ON):  Dispatch all core_net_* calls through the platform ops card
                       (core_network_ops_platform, e.g. TKL tkl_net_* on port/tuyaopen).
                       Core does not include lwIP/POSIX socket headers directly, and
                       platform-specific logic in tkl_network.c (such as cellular RRC
                       power-saving timers) is preserved.
            - n (OFF): Call the platform BSD/lwIP socket API directly via the port's
                       core_network_platform.h (default for Linux, ESP-IDF, and
                       lwIP-exposed MCU platforms).
endmenu
```

## p2p-core/Kconfig
```kconfig
menu "Configure Tuya P2P Service"

    config ENABLE_TUYA_P2P
        bool "ENABLE_TUYA_P2P: Enable Tuya P2P"
        default n
        help
            Enable Tuya P2P (ICE/RTP/streaming) and optional local media helpers.

    config P2P_STACK_WATERMARK_LOG
        bool "P2P_STACK_WATERMARK_LOG: log thread stack high-water marks"
        depends on ENABLE_TUYA_P2P
        default n
        help
            Log each P2P thread's stack high-water mark after it settles.

    if ENABLE_TUYA_P2P
    menu "P2P thread stack sizes"
        config P2P_LISTEN_STACK_SIZE
            int "P2P listen thread stack size (bytes)"
            default 4096
            range 2048 65536

        config P2P_CMD_RECV_STACK_SIZE
            int "P2P command receive thread stack size (bytes)"
            default 4096
            range 2048 65536

        config P2P_MEDIA_SEND_STACK_SIZE
            int "P2P media send thread stack size (bytes)"
            default 4096
            range 2048 65536

        config P2P_CTX_SIG_STACK_SIZE
            int "P2P signaling worker stack size (bytes)"
            default 10240
            range 2048 65536

        config P2P_RTC_WORKER_STACK_SIZE
            int "P2P RTC worker stack size (bytes)"
            default 10240
            range 2048 65536
    endmenu
    endif

    rsource "local_store/Kconfig"
    rsource "svc_ring_buffer/Kconfig"
endmenu
```
