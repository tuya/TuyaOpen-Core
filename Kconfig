## p2p-core/Kconfig
```kconfig
menu "Configure Tuya P2P Service"

    config ENABLE_TUYA_P2P
        bool "ENABLE_TUYA_P2P: Enable Tuya P2P"
        default n
        help
            Enable Tuya P2P (ICE/RTP/streaming) and optional local media helpers.

    rsource "local_store/Kconfig"
    rsource "svc_ring_buffer/Kconfig"
endmenu
```
