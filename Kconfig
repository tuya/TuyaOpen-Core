## agent-core/Kconfig
```kconfig
menu "Configure Tuya AI Service"

    config ENABLE_AI_COMPONENTS
        bool "ENABLE_AI_COMPONENTS: Enable AI components"
        default n
        help
            Master switch for the tuya.ai service layer (tuya_ai_service: AI
            protocol/transport, codec registry and the MCP server core).
            Application-side components (agent / audio player / skills / MCP
            tools) live with the application (see examples/agent_demo/components).
            Leave off for projects that do not need it so it is not compiled in.
            Maps to the CMake switch CONFIG_ENABLE_AI_COMPONENTS.

    if ENABLE_AI_COMPONENTS
        config ENABLE_AI_MONITOR
            bool "ENABLE_AI_MONITOR: Enable AI monitor (TCP debug service)"
            default y
            help
                AI protocol debug monitor service: listens on TCP (default port
                5055) and dumps the AI protocol stream for link troubleshooting.

        rsource "svc_ai_basic/Kconfig"
        # MCP server core (the tool set lives in the application and is gated
        # by the same switch)
        rsource "svc_ai_mcp/Kconfig"
    endif # ENABLE_AI_COMPONENTS
endmenu
```

## agent-core/svc_ai_basic/Kconfig
```kconfig
menu "AI Protocol Configuration"

    config AI_MAX_FRAGMENT_LENGTH
        int "AI_MAX_FRAGMENT_LENGTH: Maximum fragment length"
        range 1024 512000
        default 8192

    config ENABLE_AI_PROTO_DEBUG
        bool "ENABLE_AI_PROTO_DEBUG: Enable AI protocol debug"
        default n

    config AI_BIZ_TASK_DELAY
        int "AI_BIZ_TASK_DELAY: Business send task delay (ms)"
        range 1 10000
        default 10

    config AI_SESSION_MAX_NUM
        int "AI_SESSION_MAX_NUM: Maximum AI session count"
        range 1 5
        default 2

    config AI_BIZ_MAX_NUM
        int "AI_BIZ_MAX_NUM: Maximum AI business session ID count"
        range 5 10
        default 5

    config AI_MAX_ATTR_NUM
        int "AI_MAX_ATTR_NUM: Maximum AI attribute count"
        range 5 20
        default 10

    config AI_HEARTBEAT_INTERVAL
        int "AI_HEARTBEAT_INTERVAL: AI ping heartbeat interval (s)"
        default 120

    config AI_PACKET_SECURITY_LEVEL
        int "AI_PACKET_SECURITY_LEVEL: AI packet security level"
        range 2 4
        default 4

    config AI_CLIENT_STACK_SIZE
        int "AI_CLIENT_STACK_SIZE: AI client task stack size"
        range 2048 16384
        default 4096

    config AI_READ_SOCKET_BUF_SIZE
        int "AI_READ_SOCKET_BUF_SIZE: AI server read socket buffer size"
        default 0

    config AI_WRITE_SOCKET_BUF_SIZE
        int "AI_WRITE_SOCKET_BUF_SIZE: AI server write socket buffer size"
        default 8192

    config AI_SEND_PKT_TIMEOUT
        int "AI_SEND_PKT_TIMEOUT: AI send packet timeout (s)"
        range 1 10
        default 6

    config AI_VERSION
        int "AI_VERSION: AI protocol version"
        range 1 2
        default 2

    config AI_SUB_VERSION
        int "AI_SUB_VERSION: AI protocol sub-version"
        depends on AI_VERSION = 2
        range 1 2
        default 1
endmenu
```

## agent-core/svc_ai_mcp/Kconfig
```kconfig
menuconfig ENABLE_COMP_AI_MCP
    bool "ENABLE_COMP_AI_MCP: Enable AI MCP module"
    default n
```

## examples/linux/agent_demo/src/components/ai_audio/Kconfig
```kconfig
menuconfig ENABLE_COMP_AI_AUDIO
    bool "enable ai audio playback orchestration"
    default n
    select ENABLE_AI_PLAYER
    help
        Enable the AI audio orchestration module (src/components/ai_audio):
        TTS stream playback and music playlist playback on top of the
        audio_player component (svc_ai_player interface). Selects
        ENABLE_AI_PLAYER automatically.

        The uplink audio path goes through the port contract instead (see
        examples/agent_demo).

if (ENABLE_COMP_AI_AUDIO)
    choice AI_PLAYER_ALERT_SOURCE
        prompt "select player alert source"
        default AI_PLAYER_ALERT_SOURCE_LOCAL

        config AI_PLAYER_ALERT_SOURCE_LOCAL
            bool "use local alert source"
            help
                The local alert assets (media_src.h LOCAL_ALERT_SRC_*,
                ~2MB) are not included in this tree; alerts are skipped
                with a warning.

        config AI_PLAYER_ALERT_SOURCE_CUSTOM
            bool "use custom alert source"
            help
                The application registers its own alert callback via
                ai_audio_player_reg_alert_cb().

    endchoice
endif
```

## examples/linux/agent_demo/src/components/audio_player/Kconfig
```kconfig
# AI player switches (audio_player module).
# Defaults match CONFIG_ENABLE_AI_PLAYER in
# src/components/audio_player/CMakeLists.txt and the #ifndef fallbacks in
# svc_ai_player.h.
menuconfig ENABLE_AI_PLAYER
    bool "ENABLE_AI_PLAYER: Enable AI player"
    default n
    help
        Enable the AI audio player (MP3/WAV playback from memory, file or URL).
        Platform audio output is injected by the port through
        tuya_ai_player_set_consumer(); without it the built-in no-op consumer
        is used (decoding still runs, PCM is discarded).

    if (ENABLE_AI_PLAYER)
        config AI_PLAYER_STACK_SIZE
            int "AI_PLAYER_STACK_SIZE: player thread stack size"
            default 5120
        config AI_PLAYER_FRAMEBUF_SIZE
            int "AI_PLAYER_FRAMEBUF_SIZE: player frame buf size"
            default 4096
        config AI_PLAYER_DECODEBUF_SIZE
            int "AI_PLAYER_DECODEBUF_SIZE: player decode buf size"
            default 8192
        config AI_PLAYER_RINGBUF_SIZE
            int "AI_PLAYER_RINGBUF_SIZE: player ring buf size"
            default 16384
        config AI_PLAYER_HTTP_YIELD_MS
            int "AI_PLAYER_HTTP_YIELD_MS: player http yield ms"
            range 1 100
            default 10
        config AI_PLAYER_HTTP_TIMEOUT_S
            int "AI_PLAYER_HTTP_TIMEOUT_S: player http timeout seconds"
            range 60 300
            default 180
        menu "Decoder Options"
            # This tree has no libopus / libogg or decoder implementations;
            # enabling these switches raises a CMake FATAL_ERROR (see
            # CMakeLists.txt). The conditional structure is kept for later.
            config ENABLE_AI_PLAYER_DECODER_OPUS
                bool "ENABLE_AI_PLAYER_DECODER_OPUS: Enable OPUS decoder without any container (not available in this tree)"
                default n
            config ENABLE_AI_PLAYER_DECODER_OGGOPUS
                depends on ENABLE_AI_PLAYER_DECODER_OPUS
                bool "ENABLE_AI_PLAYER_DECODER_OGGOPUS: Enable OGGOPUS decoder (not available in this tree)"
                default n
        endmenu # Decoder Options
    endif # ENABLE_AI_PLAYER
```

## examples/linux/components/qrcode/Kconfig
```kconfig
menu "configure qrcode"

    config ENABLE_QRCODE
        bool "ENABLE_QRCODE: QR code output for Tuya APP binding"
        default n
        help
            Build the qrcode module (qrcodegen + qrencode_print) in
            examples/components/qrcode and activate the QR printing blocks in demos
            (wired binding prints the pairing QR this way).
            Maps to the CMake switch CONFIG_ENABLE_QRCODE.

endmenu
```

## examples/linux/p2p_demo/Kconfig
```kconfig
# p2p_demo configuration entry point.
#
# Each demo owns its Kconfig and its .config. Usage (requires kconfiglib:
# pip3 install --user kconfiglib):
#   cd tuyaopen-core/examples/linux/p2p_demo
#   KCONFIG_CONFIG=./.config menuconfig      # interactive configuration
#   KCONFIG_CONFIG=./.config olddefconfig    # generate with defaults
#
# This demo's CMake reads ./.config automatically (CONFIG_xxx=y is normalized
# to ON). Priority: -D command line > .config > built-in project defaults.
mainmenu "tuyaopen-core linux p2p_demo"

# Unified core switch entry (symbols match the CMake options one-to-one)
rsource "../../../Kconfig"

# Application-layer common component switches (qrcode ships with the examples)
rsource "../components/qrcode/Kconfig"

menu "configure app (p2p_demo)"

    config P2P_DEMO
        bool
        default y
        select ENABLE_TUYA_P2P
        select ENABLE_IPC_RING_BUFFER
        help
            Build tuyaopen-core/examples/linux/p2p_demo (virtual camera video source + P2P live
            streaming). Default y: p2p_demo is a standalone CMake project, and this
            switch only brings the core switches required by the P2P link
            (ENABLE_TUYA_P2P / ENABLE_IPC_RING_BUFFER) into the shared .config.
            This symbol has no prompt (it cannot be turned off interactively in
            menuconfig); simply do not build this example instead of disabling it.

    config P2P_DEMO_LOCAL_STORE
        bool "Recording and calendar playback (local_store)"
        depends on P2P_DEMO
        default n
        select ENABLE_LOCAL_STORE
        help
            Enable local recording and calendar playback (local_store). Default n:
            the live streaming path does not depend on it; when enabled, the demo
            writes encoded frames to ./media and answers the App's calendar
            query/playback requests (on Linux it writes directly to a host
            directory, with no SD card mount).

    config P2P_DEMO_WIDTH
        int "Capture width"
        depends on P2P_DEMO
        default 2304
        help
            Video width (pixels) reported to the App; it must match the video
            source file (the bundled demo_video.264 is 2304x1296), otherwise the
            reported AV capabilities do not match the actual stream.

    config P2P_DEMO_HEIGHT
        int "Capture height"
        depends on P2P_DEMO
        default 1296
        help
            Video height (pixels) reported to the App; it must match the video source file.

    config P2P_DEMO_FPS
        int "Capture fps"
        depends on P2P_DEMO
        default 15
        help
            Frame rate at which the virtual camera feeds frames (also the fps
            reported to the App). The bundled demo_video.264 is 15fps; update this
            when changing the video source.

    config P2P_DEMO_KBPS
        int "Target bitrate (kbps)"
        depends on P2P_DEMO
        default 960
        help
            Target bitrate (kbps) reported to the App. The video source is a
            fixed-bitrate file and the source side does not take part in actual
            rate control; this value only affects the AV capability report and the
            App's image quality tier selection (the bundled video is about 960kbps).

    config P2P_DEMO_GOP
        int "GOP length (frames)"
        depends on P2P_DEMO
        default 60
        help
            GOP length (frames) reported to the App. The bundled video has a fixed
            GOP of 60 frames (one IDR every 4 seconds), used by the App to estimate
            the I-frame interval.

    config P2P_DEMO_H264_FILE
        string "Live video source file (empty = bundled demo_video.264)"
        depends on P2P_DEMO
        default ""
        help
            Live video source file path. Leave empty to use the bundled video
            (demo_video.264 in the build directory, copied from
            assets/demo_video.264); when set, use that Annex-B H.264 file (AU
            boundaries are split on AUD or VCL; a stream without AUD also works).

    config P2P_DEMO_LIVE_RECORD
        bool "Live H264 record to local_store"
        depends on P2P_DEMO_LOCAL_STORE
        default n
        help
            Continuously write encoded frames to local_store during live streaming
            (default n: recorded content is only read when the App requests
            playback). When enabled, segments follow P2P_DEMO_RECORD_MAX_SEC.

    config P2P_DEMO_RECORD_MAX_SEC
        int "Max seconds per recording segment"
        depends on P2P_DEMO_LIVE_RECORD
        default 120
        range 30 3600
        help
            Maximum duration of a single recording segment (seconds); the next
            segment file is started when it expires. Default 120 seconds, range
            30-3600.

    config P2P_DEMO_PB_SEED
        bool "Boot-time playback seed from the live source file"
        depends on P2P_DEMO_LOCAL_STORE
        default n
        help
            At startup, seed today's local_store index with the live source file so
            the App can try calendar playback without any recording. Default n:
            the normal path produces playable content through recording.

endmenu
```

## iot-core/Kconfig
```kconfig
# core_system belongs to the iot-core group; its system parameter symbols are
# sourced here
rsource "core_system/Kconfig"
# mbedtls configuration menu of the connection service layer (tuya_transport)
rsource "tuya_transport/Kconfig"

menu "Configure Tuya IoT Service"

    config TUYA_SECURITY_LEVEL
        int
        range 0 3
        default 1

        help
            0: Resource-constrained devices; can only access the Tuya Cloud.
            1: Resource-constrained devices; one-way authentication.
            2: Resource-rich devices; two-way authentication.
            3: Resource-rich devices; two-way authentication with a security chip.


    config ENABLE_DEVICE_TIMER
        bool "ENABLE_DEVICE_TIMER: Enable Tuya device timer (cloud scheduled task) function"
        default n

        help
                Device timer module: sync timer tasks from the cloud (MQTT protocol 22),
                persist them into KV, and execute the DP action when a timer fires.
                Disable it to trim the code size if the device does not need cloud timers.

    menuconfig ENABLE_BT_SERVICE
        bool "ENABLE_BT_SERVICE: Enable Tuya BT IoT function"
        default n
        depends on ENABLE_BLUETOOTH

        if (ENABLE_BT_SERVICE)
            config ENABLE_BT_NETCFG
                bool "ENABLE_BT_NETCFG: Enable Tuya Bluetooth netconfig"
                default y

            config ENABLE_BT_CTRL
                bool "ENABLE_BT_CTRL: Enable Tuya Bluetooth control"
                default y

            config BT_ADV_INTERVAL_MIN
                int "BT_ADV_INTERVAL_MIN: Tuya Bluetooth minimum advertising interval (ms)"
                range 10 2000
                default 30

            config BT_ADV_INTERVAL_MAX
                int "BT_ADV_INTERVAL_MAX: Tuya Bluetooth maximum advertising interval (ms)"
                range 10 2000
                default 60

            config BT_REMOTE_CTRL_SCAN_INTERVAL
                int "BT_REMOTE_CTRL_SCAN_INTERVAL: Tuya Bluetooth remote control scan interval (ms)"
                range 10 2000
                default 30

            config BT_REMOTE_CTRL_SCAN_WINDOWS
                int "BT_REMOTE_CTRL_SCAN_WINDOWS: Tuya Bluetooth remote control scan window (ms)"
                range 10 2000
                default 10

        endif
endmenu
```

## iot-core/core_system/Kconfig
```kconfig
menu "Configure System Parameters"

    config STACK_SIZE_TIMERQ
        int "STACK_SIZE_TIMERQ: Set stack size for software timer queue"
        default 4096
        range 2048 16384

    config STACK_SIZE_WORK_QUEUE
        int "STACK_SIZE_WORK_QUEUE: Set stack size for work queue"
        default 5120
        range 2048 16384

    config MAX_NODE_NUM_WORK_QUEUE
        int "MAX_NODE_NUM_WORK_QUEUE: Set maximum node count in work queue"
        default 100
        range 10 1000

    config STACK_SIZE_MSG_QUEUE
        int "STACK_SIZE_MSG_QUEUE: Set stack size for message queue"
        default 4096
        range 2048 16384

    config MAX_NODE_NUM_MSG_QUEUE
        int "MAX_NODE_NUM_MSG_QUEUE: Set maximum node count in message queue"
        default 100
        range 10 1000
endmenu
```
